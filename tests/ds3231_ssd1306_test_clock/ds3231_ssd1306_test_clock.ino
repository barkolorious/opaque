#include <RTClib.h>
#include <SPI.h>
#include <Wire.h>
#include <Adafruit_GFX.h>
#include <Adafruit_SSD1306.h>

#define SCREEN_WIDTH 128
#define SCREEN_HEIGHT 64
#define OLED_RESET     -1
#define SCREEN_ADDRESS 0x3C


Adafruit_SSD1306 display(SCREEN_WIDTH, SCREEN_HEIGHT, &Wire, OLED_RESET);
RTC_DS3231 rtc;

char daysOfTheWeek[7][4] = {"Sun", "Mon", "Tue", "Wed", "Thu", "Fri", "Sat"};
char monthsOfTheYear[12][4] = {"Jan", "Feb", "Mar", "Apr", "May", "Jun", "Jul", "Aug", "Sep", "Oct", "Nov", "Dec"};

#define LOGO_O_HEIGHT   10
#define LOGO_O_WIDTH    20

const unsigned char logo_opaque [] PROGMEM = {
	0x7f, 0xff, 0xe3, 0xff, 0xff, 0x1f, 0xff, 0xf8, 0xff, 0xff, 0xcc, 0x00, 0x03, 0x3f, 0xff, 0xf0, 
	0xff, 0xff, 0xf7, 0xff, 0xff, 0xbf, 0xff, 0xfd, 0xff, 0xff, 0xec, 0x00, 0x03, 0x7f, 0xff, 0xf8, 
	0xc0, 0x00, 0x36, 0x00, 0x01, 0x80, 0x00, 0x0d, 0x80, 0x00, 0x6c, 0x00, 0x03, 0x60, 0x00, 0x18, 
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	0x00, 0x00, 0x06, 0x00, 0x00, 0x00, 0x00, 0x00, 0x00, 0x00, 0x60, 0x00, 0x00, 0x00, 0x00, 0x00
};

const unsigned char logo_opaque_half [] PROGMEM = {
	0x7f, 0xff, 0xe3, 0xff, 0xff, 0x00, 0x0f, 0xf8, 0xff, 0xff, 0xc7, 0xc0, 0x3e, 0x3f, 0xff, 0xf0, 
	0xff, 0xff, 0xf7, 0xff, 0xff, 0x80, 0x1f, 0xfd, 0xff, 0xff, 0xef, 0xc0, 0x3f, 0x7f, 0xff, 0xf8, 
	0xc0, 0x00, 0x36, 0x00, 0x01, 0x9f, 0xff, 0xfd, 0x80, 0x00, 0x6c, 0x00, 0x03, 0x60, 0x00, 0x18, 
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	0x00, 0x00, 0x00, 0x00, 0x00, 0x00, 0x00, 0x00, 0x00, 0x00, 0x00, 0x00, 0x00, 0x00, 0x00, 0x00
};

const unsigned char logo_o [] PROGMEM = {
	0x7f, 0xff, 0xe0, 0xff, 0xff, 0xf0, 0xc0, 0x00, 0x30, 0xc0, 0x00, 0x30, 0xc0, 0x00, 0x30, 0xc0, 
	0x00, 0x30, 0xc0, 0x00, 0x30, 0xc0, 0x00, 0x30, 0xff, 0xff, 0xf0, 0x7f, 0xff, 0xe0
};

void setup() {
  Serial.begin(115200);

  if (!rtc.begin()) {
    Serial.println("Couldn't find RTC");
    Serial.flush();
    abort();
  }

  if(!display.begin(SSD1306_SWITCHCAPVCC, SCREEN_ADDRESS)) {
    Serial.println(F("SSD1306 allocation failed"));
    for(;;);
  }

  if (rtc.lostPower()) {
    Serial.println("RTC lost power, let's set the time!");
    rtc.adjust(DateTime(F(__DATE__), F(__TIME__)));
  }

  display.clearDisplay();
  display.display();
  opening_anim();

  display.setFont();
  display.setTextColor(SSD1306_WHITE);
}

void loop() {
  DateTime now = rtc.now();

  String time = String(now.hour(), DEC);
  time += String(':');
  time += String(now.minute(), DEC);

  String date = String(monthsOfTheYear[now.month()]);
  date += String(' ');
  date += String(now.day(), DEC);
  date += String(',');
  date += daysOfTheWeek[now.dayOfTheWeek()];

  display.clearDisplay();
  
  int16_t x, y;
  uint16_t w, h;
  display.setTextSize(4);      // Normal 1:1 pixel scale
  display.getTextBounds(time.c_str(), 0, 0, &x, &y, &w, &h);
  display.setCursor(
    (display.width() - w) / 2, 
    (display.height() - h) / 2
  );
  display.println(time);

  display.setTextSize(1);      // Normal 1:1 pixel scale
  display.getTextBounds(date.c_str(), 0, (display.height() + h) / 2, &x, &y, &w, &h);
  display.setCursor(
    (display.width() - w) / 2, 
    y
  );
  display.println(date);

  display.display();

  delay(200);
}

void opening_anim (void) {
  display.clearDisplay();
  display.display();
  for (int i = 0; i < 6; i++) {
    delay(100);
    display.drawBitmap(2 + 21 * i, 27, logo_o, LOGO_O_WIDTH, LOGO_O_HEIGHT, SSD1306_WHITE);
    display.display();
  }
  delay(150);
  display.clearDisplay();
  display.drawBitmap(2, 27, logo_opaque_half, 125, 15, SSD1306_WHITE);
  display.display();
  delay(75);
  display.clearDisplay();
  display.drawBitmap(2, 27, logo_opaque, 125, 15, SSD1306_WHITE);
  display.display();
  delay(500);
}