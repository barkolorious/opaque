#include <Wire.h>
#include <SPI.h>
#include <Adafruit_GFX.h>
#include <Adafruit_SSD1306.h>
#include <MPU6050_light.h>
#include <DS3231.h>
#include <SD.h>

#define SCREEN_WIDTH   128
#define SCREEN_HEIGHT  64
#define OLED_RESET     -1
#define SCREEN_ADDRESS 0x3C
#define LOGO_O_HEIGHT  10
#define LOGO_O_WIDTH   20
#define MPU6050_DETECT_THRESHOLD 1.2

const unsigned char logo_opaque [] PROGMEM = {
	0x7f, 0xff, 0xe3, 0xff, 0xff, 0x1f, 0xff, 0xf8, 0xff, 0xff, 0xcc, 0x00, 0x03, 0x3f, 0xff, 0xf0, 
	0xff, 0xff, 0xf7, 0xff, 0xff, 0xbf, 0xff, 0xfd, 0xff, 0xff, 0xec, 0x00, 0x03, 0x7f, 0xff, 0xf8, 
	0xc0, 0x00, 0x36, 0x00, 0x01, 0x80, 0x00, 0x0d, 0x80, 0x00, 0x6c, 0x00, 0x03, 0x60, 0x00, 0x18, 
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	0x00, 0x00, 0x06, 0x00, 0x00, 0x00, 0x00, 0x00, 0x00, 0x00, 0x60, 0x00, 0x00, 0x00, 0x00, 0x00
};

const uint8_t CS = 10;

File sd;
Adafruit_SSD1306 display(SCREEN_WIDTH, SCREEN_HEIGHT, &Wire, OLED_RESET);
RTClib rtc;
MPU6050 mpu(Wire);

void setup() {
  Serial.begin(115200);
  Wire.begin();

  if(!display.begin(SSD1306_SWITCHCAPVCC, SCREEN_ADDRESS)) {
    Serial.println(F("initialization failed! (SSD1306)"));
    Serial.flush();
    return;
  }

  if (!SD.begin(CS)) {
    Serial.println(F("initialization failed! (SD)"));
    Serial.flush();
    return;
  }

  if (mpu.begin()) {
    Serial.println(F("initialization failed! (MPU6050)"));
    Serial.flush();
    return;
  }

  Serial.println(F("calibrating MPU6050"));
  delay(1000);
  mpu.calcOffsets(true,true); // gyro and accelero
  Serial.println(F("calibration done! (MPU6050)"));

  display.setTextColor(SSD1306_WHITE);
  opening_anim();
}

void loop() {
  String time, date;
  ds3231_datetime_string(&time, &date);
  ssd1306_print_datetime(time, date);
  uint8_t is_in_motion = mpu6050_is_in_motion();


  sd = SD.open("test.csv", FILE_WRITE);
  if (sd) {
    sd.print(date);
    sd.print(' ');
    sd.print(time);
    sd.print(' ');
    sd.println(is_in_motion);
    sd.close();
  }

  delay(200);
}

uint8_t mpu6050_is_in_motion (void) {
  mpu.update();
  float x = mpu.getAccX();
  float y = mpu.getAccY();
  float z = mpu.getAccZ();
  float mag = sqrt(x * x + y * y + z * z);
  return (mag > MPU6050_DETECT_THRESHOLD);
}

void ssd1306_print_datetime (String time, String date) {
  display.clearDisplay();
  int16_t x, y; uint16_t w, h;
  display.setTextSize(4);      // Normal 1:1 pixel scale
  display.getTextBounds(time.c_str(), 0, 0, &x, &x, &w, &h);
  display.setCursor((SCREEN_WIDTH - w) / 2, (SCREEN_HEIGHT - h) / 2);
  display.println(time);
  display.setTextSize(1);      // Normal 1:1 pixel scale
  display.getTextBounds(date.c_str(), 0, (SCREEN_HEIGHT + h) / 2, &x, &x, &w, &h);
  display.setCursor((SCREEN_WIDTH - w) / 2, y);
  display.println(date);
  display.display();
}

void ds3231_datetime_string (String* time, String* date) {
  DateTime now = rtc.now();

  *time = String(now.hour(), DEC);
  *time += String(':');
  *time += String(now.minute(), DEC);

  *date = String(now.day(), DEC);
  *date += String('/');
  *date += String(now.month(), DEC);
  *date += String('/');
  *date += String(now.year(), DEC);
}

void opening_anim (void) {
  display.drawBitmap(2, 27, logo_opaque, 125, 15, SSD1306_WHITE);
  display.display();
  delay(500);
}
