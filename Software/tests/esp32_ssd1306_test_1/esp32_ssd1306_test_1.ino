/*
+---------+--------+
| SSD1306 | ESP32  |
+=========+========+
| GND     | GND    |
| VCC     | 5V     |
| SDA     | GPIO21 |
| SCL     | GPIO22 | 
+---------+--------+

File > Examples > Adafruit SSD1306 > ssd1306_128x64_i2c
*/

#include <SPI.h>
#include <Wire.h>
#include <Adafruit_GFX.h>
#include <Adafruit_SSD1306.h>

#define SCREEN_WIDTH 128
#define SCREEN_HEIGHT 64

#define OLED_RESET     -1 
#define SCREEN_ADDRESS 0x3C
Adafruit_SSD1306 display(SCREEN_WIDTH, SCREEN_HEIGHT, &Wire, OLED_RESET);

#define LOGO_HEIGHT   10
#define LOGO_WIDTH    20
// 'opaque_logo', 128x64px
const unsigned char logo_opaque [] PROGMEM = {
	0x7f, 0xff, 0xe3, 0xff, 0xff, 0x1f, 0xff, 0xf8, 0xff, 0xff, 0xcc, 0x00, 0x03, 0x3f, 0xff, 0xf0, 
	0xff, 0xff, 0xf7, 0xff, 0xff, 0xbf, 0xff, 0xfd, 0xff, 0xff, 0xec, 0x00, 0x03, 0x7f, 0xff, 0xf8, 
	0xc0, 0x00, 0x36, 0x00, 0x01, 0x80, 0x00, 0x0d, 0x80, 0x00, 0x6c, 0x00, 0x03, 0x60, 0x00, 0x18, 
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	0x00, 0x00, 0x06, 0x00, 0x00, 0x00, 0x00, 0x00, 0x00, 0x00, 0x60, 0x00, 0x00, 0x00, 0x00, 0x00
};

const unsigned char logo_opaque_half [] PROGMEM = {
	0x7f, 0xff, 0xe3, 0xff, 0xff, 0x00, 0x0f, 0xf8, 0xff, 0xff, 0xc7, 0xc0, 0x3e, 0x3f, 0xff, 0xf0, 
	0xff, 0xff, 0xf7, 0xff, 0xff, 0x80, 0x1f, 0xfd, 0xff, 0xff, 0xef, 0xc0, 0x3f, 0x7f, 0xff, 0xf8, 
	0xc0, 0x00, 0x36, 0x00, 0x01, 0x9f, 0xff, 0xfd, 0x80, 0x00, 0x6c, 0x00, 0x03, 0x60, 0x00, 0x18, 
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	0x00, 0x00, 0x00, 0x00, 0x00, 0x00, 0x00, 0x00, 0x00, 0x00, 0x00, 0x00, 0x00, 0x00, 0x00, 0x00
};

const unsigned char logo_o [] PROGMEM = {
	0x7f, 0xff, 0xe0, 0xff, 0xff, 0xf0, 0xc0, 0x00, 0x30, 0xc0, 0x00, 0x30, 0xc0, 0x00, 0x30, 0xc0, 
	0x00, 0x30, 0xc0, 0x00, 0x30, 0xc0, 0x00, 0x30, 0xff, 0xff, 0xf0, 0x7f, 0xff, 0xe0
};

void setup() {
  Serial.begin(115200);

  // SSD1306_SWITCHCAPVCC = generate display voltage from 3.3V internally
  if(!display.begin(SSD1306_SWITCHCAPVCC, SCREEN_ADDRESS)) {
    Serial.println(F("SSD1306 allocation failed"));
    for(;;); // Don't proceed, loop forever
  }


  testanim();

  testdrawchar();
  delay(2000);
}

void loop() {
  testanim();
}

void testdrawchar(void) {
  display.clearDisplay();

  display.setTextSize(1);      // Normal 1:1 pixel scale
  display.setTextColor(SSD1306_WHITE); // Draw white text
  display.setCursor(0, 0);     // Start at top-left corner
  display.setFont();

  // Not all the characters will fit on the display. This is normal.
  // Library will draw what it can and the rest will be clipped.
  for(int16_t i=65; i<91; i++) {
    display.write(i);
  }

  display.write(' ');

  for(int16_t i=97; i<123; i++) {
    display.write(i);
  }

  display.display();
  delay(2000);
}

void testanim (void) {
  display.clearDisplay();
  display.display();
  for (int i = 0; i < 6; i++) {
    delay(100);
    display.drawBitmap(2 + i * 21, 27, logo_o, LOGO_WIDTH, LOGO_HEIGHT, SSD1306_WHITE);
    display.display();
  }
  delay(150);
  display.clearDisplay();
  display.drawBitmap(2, 27, logo_opaque_half, 125, 15, SSD1306_WHITE);
  display.display();
  delay(75);
  display.clearDisplay();
  display.drawBitmap(2, 27, logo_opaque, 125, 15, SSD1306_WHITE);
  display.display();
  delay(1000);
}


